## drivers/thermal/intelli/Kconfig
```kconfig
config INTELLI_THERMAL_V2
	bool "Better thermal monitor for MSM"
	depends on THERMAL_TSENS8974
	depends on CPU_FREQ_MSM
	help
	  This enables thermal monitoring capability in the kernel replacing
	  userspace thermal monitoring altogether.
```
